## arch/arm/mach-qcom/Kconfig
```kconfig
# SPDX-License-Identifier: GPL-2.0-only
menuconfig ARCH_QCOM
	bool "Qualcomm Support"
	depends on ARCH_MULTI_V7
	select ARM_GIC
	select ARM_AMBA
	select CLKSRC_QCOM
	select HAVE_ARM_ARCH_TIMER
	select PINCTRL
	select QCOM_SCM if SMP
	help
	  Support for Qualcomm's devicetree based systems.
	  This includes support for a few devices with ARM64 SoC, that have
	  ARM32 signed firmware that does not allow booting ARM64 kernels.

if ARCH_QCOM

config ARCH_QCOM_RESERVE_SMEM
	bool "Reserve SMEM at the beginning of RAM"
	help
	  Reserve 2MB at the beginning of the System RAM for shared mem.
	  This is required on IPQ40xx, MSM8x60 and MSM8960 platforms.

config ARCH_MDM9607
	bool "Enable support for MDM9607"
	select ARM_GIC
	select CPU_V7
	select REGULATOR
	select REGULATOR_RPM_SMD
	select HAVE_ARM_ARCH_TIMER
	select MSM_RPM_SMD
	select MEMORY_HOLE_CARVEOUT
	select MSM_CORTEX_A7
	select PINCTRL
	select QCOM_GDSC
	select USE_PINCTRL_IRQ
	select MSM_IRQ
	select MSM_PM if PM
	select PM_DEVFREQ
	select MSM_DEVFREQ_DEVBW
	select MSM_BIMC_BWMON
	select DEVFREQ_GOV_MSM_BW_HWMON
	select HWSPINLOCK
	select MTD_UBI
	select HAVE_CLK_PREPARE
	help
	  Enable support for MDM9607.

	  This enables support for MDM9607 SoC devicetree based systems.
	  If you do not wish to build a kernel that runs on this
	  chipset or if you are unsure, say 'N' here.
endif
```

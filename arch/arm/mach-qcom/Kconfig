## drivers/misc/awinic/Kconfig
```kconfig
# SPDX-License-Identifier: GPL-2.0-only
menuconfig INPUT_AWINIC_HAPTIC
	bool "Awinic Haptic"
	help
	  Enables Awinic Haptic driver.

source "drivers/misc/awinic/aw862x/Kconfig"
```

## drivers/misc/awinic/aw862x/Kconfig
```kconfig
# SPDX-License-Identifier: GPL-2.0-only
config AW862X_HAPTIC
	tristate "Awinic AW862x haptics"
	depends on INPUT_AWINIC_HAPTIC && I2C
	help
	  Driver for the Awinic AW8622x, AW86214 and AW8624 haptic drivers
	  (compatible "awinic,haptic_nv"), as used on Motorola dubai.
```
